## sdkconfig.defaults
```kconfig
# Target
CONFIG_IDF_TARGET="esp32s3"

# Partition table
CONFIG_PARTITION_TABLE_CUSTOM=y
CONFIG_PARTITION_TABLE_CUSTOM_FILENAME="partitions.csv"

# Flash size (4MB, two OTA partitions ~1.9MB each)
CONFIG_ESPTOOLPY_FLASHSIZE_4MB=y

# WiFi
CONFIG_ESP_WIFI_SOFTAP_SUPPORT=y

# HTTPD
CONFIG_HTTPD_MAX_REQ_HDR_LEN=1024
CONFIG_HTTPD_MAX_URI_LEN=512
CONFIG_HTTPD_WS_SUPPORT=y

# LWIP
CONFIG_LWIP_MAX_SOCKETS=16

# FreeRTOS
CONFIG_FREERTOS_HZ=1000

# Log level
CONFIG_LOG_DEFAULT_LEVEL_INFO=y

# NVS
CONFIG_NVS_ENCRYPTION=n

# UART
CONFIG_ESP_CONSOLE_USB_SERIAL_JTAG=y
```
